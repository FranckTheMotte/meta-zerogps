## conf/distro/fourcat.conf
```bitbake
require conf/distro/poky.conf

DISTRO = "fourcat"
DISTRO_NAME = "Fourcat (based on Poky Distro)"
DISTRO_VERSION = "1.0"

# The raspberrypi build depends on non-free firmware that includes the Synaptics license.
LICENSE_FLAGS_ACCEPTED += "synaptics-killswitch"

DISTRO_FEATURES:append = " bluetooth"

PACKAGECONFIG:append:pn-bluez5 = " tools"
```

## conf/layer.conf
```bitbake
# We have a conf and classes directory, add to BBPATH
BBPATH .= ":${LAYERDIR}"

# We have recipes-* directories, add to BBFILES
BBFILES += "${LAYERDIR}/recipes-*/*/*.bb \
            ${LAYERDIR}/recipes-*/*/*.bbappend"

BBFILE_COLLECTIONS += "meta-zerogps"
BBFILE_PATTERN_meta-zerogps = "^${LAYERDIR}/"
BBFILE_PRIORITY_meta-zerogps = "10"

LAYERDEPENDS_meta-zerogps = "core"
LAYERDEPENDS_meta-zerogps += "raspberrypi"
LAYERSERIES_COMPAT_meta-zerogps = "wrynose"
```

## conf/machine/raspberrypi0-2w-64-dev.conf
```bitbake
require conf/machine/raspberrypi0-2w-64.conf

MACHINEOVERRIDES =. "raspberrypi0-2w-64-dev:"

ENABLE_UART = "1"
```
